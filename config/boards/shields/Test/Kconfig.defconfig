## config/boards/shields/Test/Kconfig.defconfig
```kconfig
if SHIELD_ZMKCHARYBDIS_R

config ZMK_KEYBOARD_NAME
    default "zmkcharybdis_R"

config ZMK_SPLIT
    default y

config ZMK_SPLIT_ROLE_CENTRAL
    default y

endif

if SHIELD_ZMKCHARYBDIS_L

config ZMK_KEYBOARD_NAME
    default "zmkcharybdis_L"

config ZMK_SPLIT
    default y

endif
```

## config/boards/shields/Test/Kconfig.shield
```kconfig
config SHIELD_ZMKCHARYBDIS_R
    def_bool $(shields_list_contains,zmkcharybdis_R)

config SHIELD_ZMKCHARYBDIS_L
    def_bool $(shields_list_contains,zmkcharybdis_L)
```
